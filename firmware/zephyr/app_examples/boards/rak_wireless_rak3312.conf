## firmware/zephyr/west/west.yml
```yaml
manifest:
  version: 0.12

  remotes:
    - name: zephyrproject
      url-base: https://github.com/zephyrproject-rtos

  projects:
    - name: zephyr
      remote: zephyrproject
      repo-path: zephyr
      revision: v4.4.0
      import:
        name-allowlist:
          - hal_espressif
          - cmsis
          - mbedtls
          - tinycrypt
          - tf-psa-crypto
          - esp-idf
          - fatfs
          - mcuboot
          - picolibc
          - littlefs

  self:
    path: app
```

## zephyr_workspace/app_examples/Kconfig
```kconfig
config ZSN_STATUS_CLASS
    bool "Enable status class"
    default y if BOARD_ADAFRUIT_FEATHER_ESP32S3_ESP32S3_PROCPU || BOARD_ADAFRUIT_FEATHER_ESP32S3_ESP32S3_APPCPU
    help
    Enables the status class implementation for supported boards.

config WIFI_SSID
    string "WiFi SSID"
    default "YourSSID"
    help
      The SSID of the WiFi network to connect to.

config WIFI_PSK
    string "WiFi Password"
    default "YourPassword"
    help
      The WPA2 passphrase for the WiFi network.

source "Kconfig.zephyr"
```

## firmware/zephyr/app_sensor_node/Kconfig
```kconfig
config ZSN_STATUS_CLASS
    bool "Enable status class"
    default y if BOARD_ADAFRUIT_FEATHER_ESP32S3_ESP32S3_PROCPU || BOARD_ADAFRUIT_FEATHER_ESP32S3_ESP32S3_APPCPU
    help
    Enables the status class implementation for supported boards.

source "Kconfig.zephyr"
```

## firmware/zephyr/astro_custom_modules/gnss/mtk/Kconfig
```kconfig
# Copyright (c) 2024 CATIE
# SPDX-License-Identifier: Apache-2.0

rsource "mtk3333/Kconfig"
```

## zephyr_workspace/app_examples/boards/rak_wireless_rak3312_ble.conf
```kconfig
# Bluetooth configuration
CONFIG_BT=y
CONFIG_BT_PERIPHERAL=y
CONFIG_BT_DEVICE_NAME="RAK3312_UART"
CONFIG_BT_DEVICE_APPEARANCE=833

# GATT configuration
CONFIG_BT_GATT_DYNAMIC_DB=y
CONFIG_BT_ATT_PREPARE_COUNT=2

# Logging
CONFIG_LOG=y
CONFIG_LOG_DEFAULT_LEVEL=3

# Main stack size
CONFIG_MAIN_STACK_SIZE=2048

# System workqueue stack size
CONFIG_SYSTEM_WORKQUEUE_STACK_SIZE=2048

# Enable console for debugging
CONFIG_CONSOLE=y
CONFIG_UART_CONSOLE=y

CONFIG_ESP_SPIRAM=y
CONFIG_SPIRAM_MODE_OCT=y
CONFIG_ESP_SPIRAM_MEMTEST=y
```

## zephyr_workspace/app_sensor_node/boards/nicla-vision.conf
```kconfig
# USB device (new stack)
CONFIG_USB_DEVICE_STACK_NEXT=y
CONFIG_USB_DEVICE_PRODUCT="Nicla Vision CDC"
CONFIG_USB_DEVICE_MANUFACTURER="Arduino"

# CDC ACM class
CONFIG_USB_CDC_ACM=y

# Console over USB
CONFIG_SERIAL=y
CONFIG_UART_CONSOLE=y
CONFIG_CONSOLE=y
# CONFIG_USB_UART_CONSOLE=y

# Logging (optional but useful)
CONFIG_LOG=y
CONFIG_LOG_MODE_DEFERRED=y
CONFIG_MICROROS_TRANSPORT_SERIAL=y
```

## zephyr_workspace/app_sensor_node/boards/pimoroni_pico_plus_2w.conf
```kconfig
CONFIG_MICROROS_TRANSPORT_SERIAL=y
CONFIG_USB_DEVICE_STACK_NEXT=y
CONFIG_USBD_CDC_ACM_CLASS=y
CONFIG_CDC_ACM_SERIAL_INITIALIZE_AT_BOOT=y
CONFIG_CDC_ACM_SERIAL_ENABLE_AT_BOOT=y
CONFIG_CDC_ACM_SERIAL_MANUFACTURER_STRING="Zephyr Project"
CONFIG_CDC_ACM_SERIAL_PRODUCT_STRING="Pimoroni Pico plus 2W"
```

## zephyr_workspace/astro_custom_modules/gnss/Kconfig
```kconfig
# Copyright (c) 2024 CATIE
# SPDX-License-Identifier: Apache-2.0

if GNSS

rsource "mtk/Kconfig"

endif # GNSS
```

## zephyr_workspace/astro_custom_modules/gnss/mtk/mtk3333/Kconfig
```kconfig
menuconfig MTK3333
    bool "MTK3333 GNSS i2c module"
    default y
	depends on GNSS
    select I2C
    select MODEM_MODULES
	select MODEM_CHAT
	select GNSS_PARSE
	select GNSS_NMEA0183
	select GNSS_NMEA0183_MATCH
	help
	  Enable driver for MTK3333 GNSS i2c driver.

if MTK3333

config MTK3333_VERBOSE_LOGGING
    bool "Enable verbose logging for MTK3333"
    default n
    depends on MTK3333
    help
      Enable verbose debug logging for the MTK3333 GNSS driver.
      This will output detailed I2C transactions, NMEA sentences,
      and internal state information to the log.
      If unsure, say N.

endif # MTK3333
```

## zephyr_workspace/astro_custom_modules/iim42652_rak12033/dts/bindings/sensor/tdk,iim42652.yaml
```yaml
# Copyright (c) 2024 CATIE
# SPDX-License-Identifier: Apache-2.0

description: TDK IIM42652 6-axis IMU

compatible: "tdk,iim42652"

include:
  - name: sensor-device.yaml
  - name: i2c-device.yaml

properties:
    irq-gpios:
        type: phandle-array
        description: Configures iim42652 interrupt signal.

    use_xtal:
        type: boolean
        description: |
            Enable the use of external crystal.
```

## zephyr_workspace/astro_custom_modules/iim42652_rak12033/tdk/iim42652/Kconfig
```kconfig
#Copyright(c) 2026
#SPDX - License - Identifier : Apache - 2.0

menuconfig IIM42652
    bool "TDK IIM42652 6-axis IMU"
    default y
    depends on DT_HAS_TDK_IIM42652_ENABLED
    select I2C
    help
      Enable driver for TDK IIM42652 6-axis IMU.

if IIM42652

config IIM42652_ACC_CUSTOM_CONFIG
    bool "Accelerometer custom configuration"
    default n
    depends on IIM42652
    help
      Enable Accelerometer configuration customization.

if IIM42652_ACC_CUSTOM_CONFIG

choice
    prompt "Range configuration"
    default IIM42652_ACC_4G_RANGE

config IIM42652_ACC_2G_RANGE
    bool "2G"
    depends on IIM42652_ACC_CUSTOM_CONFIG

config IIM42652_ACC_4G_RANGE
    bool "4G"
    depends on IIM42652_ACC_CUSTOM_CONFIG

config IIM42652_ACC_8G_RANGE
    bool "8G"
    depends on IIM42652_ACC_CUSTOM_CONFIG

config IIM42652_ACC_16G_RANGE
    bool "16G"
    depends on IIM42652_ACC_CUSTOM_CONFIG

endchoice

choice
    prompt "Bandwidth configuration"
    default IIM42652_ACC_62HZ_BANDWIDTH

config IIM42652_ACC_8HZ_BANDWIDTH
    bool "7.81Hz"
    depends on IIM42652_ACC_CUSTOM_CONFIG

config IIM42652_ACC_16HZ_BANDWIDTH
    bool "15.63Hz"
    depends on IIM42652_ACC_CUSTOM_CONFIG

config IIM42652_ACC_31HZ_BANDWIDTH
    bool "31.25Hz"
    depends on IIM42652_ACC_CUSTOM_CONFIG

config IIM42652_ACC_62HZ_BANDWIDTH
    bool "62.5Hz"
    depends on IIM42652_ACC_CUSTOM_CONFIG

config IIM42652_ACC_125HZ_BANDWIDTH
    bool "125Hz"
    depends on IIM42652_ACC_CUSTOM_CONFIG

config IIM42652_ACC_250HZ_BANDWIDTH
    bool "250Hz"
    depends on IIM42652_ACC_CUSTOM_CONFIG

config IIM42652_ACC_500HZ_BANDWIDTH
    bool "500Hz"
    depends on IIM42652_ACC_CUSTOM_CONFIG

config IIM42652_ACC_1000HZ_BANDWIDTH
    bool "1000Hz"
    depends on IIM42652_ACC_CUSTOM_CONFIG

endchoice

choice
    prompt "Power mode configuration"
    default IIM42652_ACC_NORMAL_POWER

config IIM42652_ACC_NORMAL_POWER
    bool "Normal"
    depends on IIM42652_ACC_CUSTOM_CONFIG

config IIM42652_ACC_LOW_1_POWER
    bool "Low Power 1"
    depends on IIM42652_ACC_CUSTOM_CONFIG

config IIM42652_ACC_LOW_2_POWER
    bool "Low Power 2"
    depends on IIM42652_ACC_CUSTOM_CONFIG

config IIM42652_ACC_STANDBY_POWER
    bool "Standby"
    depends on IIM42652_ACC_CUSTOM_CONFIG

config IIM42652_ACC_SUSPEND_POWER
    bool "Suspend"
    depends on IIM42652_ACC_CUSTOM_CONFIG

config IIM42652_ACC_DEEP_SUSPEND_POWER
    bool "Deep Suspend"
    depends on IIM42652_ACC_CUSTOM_CONFIG

endchoice

endif # IIM42652_ACC_CUSTOM_CONFIG

config IIM42652_MAG_CUSTOM_CONFIG
    bool "Magnetometer custom configuration"
    default n
    depends on IIM42652
    help
      Enable Magnetometer configuration customization.

if IIM42652_MAG_CUSTOM_CONFIG

choice
    prompt "Output Rate configuration"
    default IIM42652_MAG_20HZ_RATE

config IIM42652_MAG_2HZ_RATE
    bool "2Hz"
    depends on IIM42652_MAG_CUSTOM_CONFIG

config IIM42652_MAG_6HZ_RATE
    bool "6Hz"
    depends on IIM42652_MAG_CUSTOM_CONFIG

config IIM42652_MAG_8HZ_RATE
    bool "8Hz"
    depends on IIM42652_MAG_CUSTOM_CONFIG

config IIM42652_MAG_10HZ_RATE
    bool "10Hz"
    depends on IIM42652_MAG_CUSTOM_CONFIG

config IIM42652_MAG_15HZ_RATE
    bool "15Hz"
    depends on IIM42652_MAG_CUSTOM_CONFIG

config IIM42652_MAG_20HZ_RATE
    bool "20Hz"
    depends on IIM42652_MAG_CUSTOM_CONFIG

config IIM42652_MAG_25HZ_RATE
    bool "25Hz"
    depends on IIM42652_MAG_CUSTOM_CONFIG

config IIM42652_MAG_30HZ_RATE
    bool "30Hz"
    depends on IIM42652_MAG_CUSTOM_CONFIG

endchoice

choice
    prompt "Operation mode configuration"
    default IIM42652_MAG_REGULAR_MODE

config IIM42652_MAG_LOW_POWER_MODE
    bool "Low Power"
    depends on IIM42652_MAG_CUSTOM_CONFIG

config IIM42652_MAG_REGULAR_MODE
    bool "Regular"
    depends on IIM42652_MAG_CUSTOM_CONFIG

config IIM42652_MAG_ENHANCED_REGULAR_MODE
    bool "Enhanced Regular"
    depends on IIM42652_MAG_CUSTOM_CONFIG

config IIM42652_MAG_HIGH_ACCURACY_MODE
    bool "High Accuracy"
    depends on IIM42652_MAG_CUSTOM_CONFIG

endchoice

choice
    prompt "Power mode configuration"
    default IIM42652_MAG_FORCED_POWER

config IIM42652_MAG_NORMAL_POWER
    bool "Normal"
    depends on IIM42652_MAG_CUSTOM_CONFIG

config IIM42652_MAG_SUSPEND_POWER
    bool "Suspend"
    depends on IIM42652_MAG_CUSTOM_CONFIG

config IIM42652_MAG_SLEEP_POWER
    bool "Sleep"
    depends on IIM42652_MAG_CUSTOM_CONFIG

config IIM42652_MAG_FORCED_POWER
    bool "Forced"
    depends on IIM42652_MAG_CUSTOM_CONFIG

endchoice

endif # IIM42652_MAG_CUSTOM_CONFIG

config IIM42652_GYR_CUSTOM_CONFIG
    bool "Gyroscope custom configuration"
    default n
    depends on IIM42652
    help
      Enable Gyroscope configuration customization.

if IIM42652_GYR_CUSTOM_CONFIG

choice
    prompt "Range configuration"
    default IIM42652_GYR_2000_RANGE

config IIM42652_GYR_125_RANGE
    bool "125"
    depends on IIM42652_GYR_CUSTOM_CONFIG

config IIM42652_GYR_250_RANGE
    bool "250"
    depends on IIM42652_GYR_CUSTOM_CONFIG

config IIM42652_GYR_500_RANGE
    bool "500"
    depends on IIM42652_GYR_CUSTOM_CONFIG

config IIM42652_GYR_1000_RANGE
    bool "1000"
    depends on IIM42652_GYR_CUSTOM_CONFIG

config IIM42652_GYR_2000_RANGE
    bool "2000"
    depends on IIM42652_GYR_CUSTOM_CONFIG

endchoice

choice
    prompt "Bandwidth configuration"
    default IIM42652_GYR_32HZ_BANDWIDTH

config IIM42652_GYR_12HZ_BANDWIDTH
    bool "12Hz"
    depends on IIM42652_GYR_CUSTOM_CONFIG

config IIM42652_GYR_23HZ_BANDWIDTH
    bool "23Hz"
    depends on IIM42652_GYR_CUSTOM_CONFIG

config IIM42652_GYR_32HZ_BANDWIDTH
    bool "32Hz"
    depends on IIM42652_GYR_CUSTOM_CONFIG

config IIM42652_GYR_47HZ_BANDWIDTH
    bool "47Hz"
    depends on IIM42652_GYR_CUSTOM_CONFIG

config IIM42652_GYR_64HZ_BANDWIDTH
    bool "64Hz"
    depends on IIM42652_GYR_CUSTOM_CONFIG

config IIM42652_GYR_116HZ_BANDWIDTH
    bool "116Hz"
    depends on IIM42652_GYR_CUSTOM_CONFIG

config IIM42652_GYR_230HZ_BANDWIDTH
    bool "230Hz"
    depends on IIM42652_GYR_CUSTOM_CONFIG

config IIM42652_GYR_523HZ_BANDWIDTH
    bool "523Hz"
    depends on IIM42652_GYR_CUSTOM_CONFIG

endchoice

choice
    prompt "Power mode configuration"
    default IIM42652_GYR_NORMAL_POWER

config IIM42652_GYR_NORMAL_POWER
    bool "Normal"
    depends on IIM42652_GYR_CUSTOM_CONFIG

config IIM42652_GYR_FAST_POWER
    bool "Fast Power Up"
    depends on IIM42652_GYR_CUSTOM_CONFIG

config IIM42652_GYR_SUSPEND_POWER
    bool "Suspend"
    depends on IIM42652_GYR_CUSTOM_CONFIG

config IIM42652_GYR_DEEP_SUSPEND_POWER
    bool "Deep Suspend"
    depends on IIM42652_GYR_CUSTOM_CONFIG

config IIM42652_GYR_POWERSAVE_POWER
    bool "Advanced Powersave"
    depends on IIM42652_GYR_CUSTOM_CONFIG

endchoice

endif # IIM42652_GYR_CUSTOM_CONFIG

config IIM42652_TRIGGER
    bool "IRQ Trigger"
    help
      Enable IRQ pin to trigger software interruption.

endif # IIM42652
```

## zephyr_workspace/example_apps/boards/rak_wireless_rak3312.conf
```kconfig
# USB device (new stack)
CONFIG_USB_DEVICE_STACK_NEXT=y
CONFIG_USB_DEVICE_PRODUCT="ESP32_S3"
CONFIG_USB_DEVICE_MANUFACTURER="RAK Wireless"

# CDC ACM class
CONFIG_USB_CDC_ACM=y

# Console over USB
CONFIG_SERIAL=y
CONFIG_UART_CONSOLE=y
CONFIG_UART_INTERRUPT_DRIVEN=y
CONFIG_CONSOLE=y

# Logging (optional but useful)
CONFIG_LOG=y
CONFIG_LOG_MODE_DEFERRED=y

CONFIG_MICROROS_TRANSPORT_SERIAL_USB=y

CONFIG_PRINTK=y
CONFIG_LOG_DEFAULT_LEVEL=4

#Sensors
CONFIG_I2C=y
CONFIG_SENSOR=y
CONFIG_SENSOR_LOG_LEVEL_DBG=y
CONFIG_CBPRINTF_FP_SUPPORT=y
CONFIG_CBPRINTF_COMPLETE=y
CONFIG_GPIO=y
CONFIG_IIM42652=y

CONFIG_DISPLAY=y
CONFIG_SSD1306=y
CONFIG_SSD1306_DEFAULT_CONTRAST=128
CONFIG_CHARACTER_FRAMEBUFFER=y
CONFIG_CHARACTER_FRAMEBUFFER_USE_DEFAULT_FONTS=y
CONFIG_CFB_LOG_LEVEL_INF=y

CONFIG_GNSS=y
CONFIG_GNSS_SATELLITES=y
CONFIG_MTK3333=y

CONFIG_ESP_SPIRAM=y
CONFIG_SPIRAM_MODE_OCT=y
CONFIG_ESP_SPIRAM_MEMTEST=y

CONFIG_WATCHDOG=y
CONFIG_WDT_LOG_LEVEL_INF=y
CONFIG_HWINFO=y

# Enable LED driver
CONFIG_LED=y
CONFIG_PM=n
CONFIG_PM_DEVICE=n
CONFIG_PM_DEVICE_RUNTIME=n
```

## zephyr_workspace/sd_card_fs_app/Kconfig
```kconfig
config ZSN_STATUS_CLASS
    bool "Enable status class"
    default y if BOARD_ADAFRUIT_FEATHER_ESP32S3_ESP32S3_PROCPU || BOARD_ADAFRUIT_FEATHER_ESP32S3_ESP32S3_APPCPU
    help
    Enables the status class implementation for supported boards.

config APP_PURGE_SD_ON_BOOT
    bool "Purge SD card on boot"
    default n
    help
    If enabled, all files and directories on the SD card
    will be deleted at boot after mounting.


source "Kconfig.zephyr"
```

## zephyr_workspace/sd_card_fs_app/boards/rak_wireless_rak3312.conf
```kconfig
# USB device (new stack)
CONFIG_USB_DEVICE_STACK_NEXT=y
CONFIG_USB_DEVICE_PRODUCT="ESP32_S3"
CONFIG_USB_DEVICE_MANUFACTURER="RAK Wireless"

# CDC ACM class
CONFIG_USB_CDC_ACM=y

# Console over USB
CONFIG_SERIAL=y
CONFIG_UART_CONSOLE=y
CONFIG_UART_INTERRUPT_DRIVEN=y
CONFIG_CONSOLE=y

# Logging (optional but useful)
CONFIG_LOG=y
CONFIG_LOG_MODE_DEFERRED=y

CONFIG_MICROROS_TRANSPORT_SERIAL_USB=y

CONFIG_PRINTK=y
CONFIG_LOG_DEFAULT_LEVEL=3

#Sensors
CONFIG_I2C=y
CONFIG_SENSOR=y
CONFIG_SENSOR_LOG_LEVEL_DBG=y
CONFIG_CBPRINTF_FP_SUPPORT=y
CONFIG_CBPRINTF_COMPLETE=y
CONFIG_GPIO=y
CONFIG_IIM42652=y

CONFIG_DISPLAY=y
CONFIG_SSD1306=y
CONFIG_SSD1306_DEFAULT_CONTRAST=128
CONFIG_CHARACTER_FRAMEBUFFER=y
CONFIG_CHARACTER_FRAMEBUFFER_USE_DEFAULT_FONTS=y
CONFIG_CFB_LOG_LEVEL_INF=y

CONFIG_GNSS=y
CONFIG_GNSS_SATELLITES=y
CONFIG_MTK3333=y

CONFIG_ESP_SPIRAM=y
CONFIG_SPIRAM_MODE_OCT=y
CONFIG_ESP_SPIRAM_MEMTEST=y

CONFIG_WATCHDOG=y
CONFIG_WDT_LOG_LEVEL_INF=y
CONFIG_HWINFO=y

# SDMMC
# Replace LittleFS with FAT
CONFIG_FILE_SYSTEM=y
CONFIG_FAT_FILESYSTEM_ELM=y  # Instead of CONFIG_FILE_SYSTEM_LITTLEFS
# Remove: CONFIG_FS_LITTLEFS_BLK_DEV
# Remove: All CONFIG_FS_LITTLEFS_* settings
CONFIG_FILE_SYSTEM_MKFS=y

CONFIG_DISK_ACCESS=y
CONFIG_DISK_DRIVER_SDMMC=y
CONFIG_SPI=y
CONFIG_GPIO=y
# Enable FAT Long Filename support
CONFIG_FS_FATFS_LFN=y
CONFIG_FS_FATFS_LFN_MODE_HEAP=y
# Custom config
CONFIG_APP_PURGE_SD_ON_BOOT=n

# Shell access
CONFIG_SHELL=y
CONFIG_SHELL_BACKEND_SERIAL=y
CONFIG_FILE_SYSTEM_SHELL=y
CONFIG_KERNEL_SHELL=y
```

## zephyr_workspace/west/west.yml
```yaml
manifest:
  version: 0.12

  remotes:
    - name: zephyrproject
      url-base: https://github.com/zephyrproject-rtos

  projects:
    - name: zephyr
      remote: zephyrproject
      repo-path: zephyr
      revision: v4.3.0
      import:
        name-allowlist:
          - hal_espressif
          - cmsis
          - mbedtls
          - tinycrypt
          - esp-idf
          - fatfs
          - mcuboot
          - picolibc
          - littlefs

  self:
    path: app
```

## zephyr_workspace/zephyr_sensor_node/modules/gnss/dts/bindings/gnss/adafruit,mtk3333.yaml
```yaml
description: Adafruit Ultimate GPS Breakout using MTK3333 GNSS chipset (I2C)

compatible: "adafruit,mtk3333"

include: i2c-device.yaml

properties:
  reg:
    required: true

  label:
    type: string
    required: true
```

## zephyr_workspace/zephyr_sensor_node/modules/gnss/mtk/mtk3333/Kconfig
```kconfig
menuconfig MTK3333
    bool "MTK3333 GNSS i2c module"
    default y
	depends on GNSS
    select I2C
    select MODEM_MODULES
	select MODEM_CHAT
	select GNSS_PARSE
	select GNSS_NMEA0183
	select GNSS_NMEA0183_MATCH
	help
	  Enable driver for MTK3333 GNSS i2c driver.
```
